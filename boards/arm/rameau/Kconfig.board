## boards/arm/rameau/Kconfig.board
```kconfig
config BOARD_RAMEAU
    bool "Rameau Keyboard Board"
    depends on SOC_STM32U073XX
```

## boards/arm/rameau/Kconfig.defconfig
```kconfig
if BOARD_RAMEAU

config BOARD
    default "rameau"

if USB_DEVICE_STACK

config USB_DEVICE_VID
    default 0x1D50

config USB_DEVICE_PID
    default 0x615E

config USB_DEVICE_MANUFACTURER
    default "GK Keyboards"

config USB_DEVICE_PRODUCT
    default "Rameau"

endif # USB_DEVICE_STACK

endif # BOARD_RAMEAU
```

## boards/arm/rameau/rameau_defconfig
```kconfig
# Your existing config...
CONFIG_SOC_SERIES_STM32U0X=y
CONFIG_SOC_STM32U073XX=y
CONFIG_BOARD_RAMEAU=y
CONFIG_CLOCK_CONTROL=y
CONFIG_GPIO=y
CONFIG_ADC=y
CONFIG_PINCTRL=y
CONFIG_USB_DEVICE_STACK=y
CONFIG_USB_DEVICE_HID=y
CONFIG_ZMK_USB=y
CONFIG_ZMK_KEYBOARD_NAME="Rameau"
CONFIG_ZMK_KSCAN_DEBOUNCE_PRESS_MS=5
CONFIG_ZMK_KSCAN_DEBOUNCE_RELEASE_MS=5
CONFIG_ZMK_GK_HYBRID_MATRIX=y
CONFIG_SETTINGS=y

# Enable UART logging (your existing)
CONFIG_LOG=y
CONFIG_SERIAL=y
CONFIG_CONSOLE=y
CONFIG_UART_CONSOLE=y
CONFIG_PRINTK=y
CONFIG_ZMK_LOG_LEVEL_DBG=y
CONFIG_LOG_DEFAULT_LEVEL=4
CONFIG_UART_INTERRUPT_DRIVEN=y

# ENABLE ZMK BLE FIRST (this was the missing piece!)
CONFIG_ZMK_BLE=y

# Then configure BLE to use external controller
CONFIG_BT=y
#CONFIG_BT_HOST=y
CONFIG_BT_HCI=y
CONFIG_BT_LL_SW_SPLIT=n

# Disable built-in BLE controller  
#CONFIG_BT_CTLR=n

# Enable HCI UART transport
#CONFIG_BT_HCI_UART=y
#CONFIG_BT_HCI_UART_BAUDRATE=115200

# Keep ZMK BLE features
#CONFIG_BT_PERIPHERAL=y
#CONFIG_BT_GATT_SERVICE_CHANGED=y
```
